## ext_tree/Config.in
```kconfig
menu "Custom packages"
	source "../ext_tree/package/alsa-drain-wrapper/Config.in"
	source "../ext_tree/package/naa/Config.in"
endmenu
```

## ext_tree/package/alsa-drain-wrapper/Config.in
```kconfig
config BR2_PACKAGE_ALSA_DRAIN_WRAPPER
	bool "alsa-drain-wrapper"
	depends on BR2_PACKAGE_ALSA_LIB
	help
	  LD_PRELOAD wrapper to convert snd_pcm_drain() to snd_pcm_drop()
	  Prevents 10-second timeout when slave loses clocks during drain.
```

## ext_tree/package/llmnrd/Config.in
```kconfig
config BR2_PACKAGE_LLMNRD
	bool "llmnrd"
	help
	  Link-Local Multicast Name Resolution daemon.
	  Allows Linux to resolve plain hostnames (without .local suffix)
	  on local networks, compatible with Windows LLMNR resolution.

	  https://github.com/tklauser/llmnrd
```

## ext_tree/package/sync-node/Config.in
```kconfig
config BR2_PACKAGE_SYNC_NODE
	bool "sync-node"
	help
	  Lightweight UDP-based I2S sync daemon for shared-clock
	  multi-node audio. Measures drift between master and slave
	  frame counters, applies drift_ppb correction.
```

## ext_tree/package/zerotier-one/Config.in
```kconfig
config BR2_PACKAGE_ZEROTIERONE
    bool "zerotier-one"
    depends on BR2_INSTALL_LIBSTDCPP
    select BR2_PACKAGE_LIBMINIUPNPC
    help
      ZeroTier One creates secure virtual networks anywhere.
      
      ZeroTier creates a virtual ethernet adapter for each
      network you join.

      https://www.zerotier.com/
```
